## conf/layer.conf
```bitbake
# We have a conf and classes directory, add to BBPATH
BBPATH .= ":${LAYERDIR}"

# We have a recipes-* directories, add to BBFILES
BBFILES += "${LAYERDIR}/recipes-*/*/*.bb \
	${LAYERDIR}/recipes-*/*/*.bbappend"

BBFILE_COLLECTIONS += "engicam"
BBFILE_PATTERN_engicam = "^${LAYERDIR}/"
BBFILE_PRIORITY_engicam = "6"
LAYERSERIES_COMPAT_engicam = "sumo"
```

## conf/machine/geam6ul.conf
```bitbake
#@TYPE: Machine
#@NAME: geam6ul

#@DESCRIPTION: Machine configuration for engicam system
#EDIMM board with Geam SOM
#Above combination supports MMC and NAND booting

PREFERRED_PROVIDER_virtual/xserver ?= "xserver-xorg"
XSERVER ?= "xserver-xorg \
           xf86-video-fbdev \
           "

MACHINE_EXTRA_RRECOMMENDS = " kernel-modules kernel-devicetree"

include conf/machine/include/tune-cortexa9.inc
DEFAULTTUNE_geam6ul ?= "cortexa9thf-vfpv3"

IMAGE_FSTYPES += "wic"

SERIAL_CONSOLE = "115200 ttymxc0"

PREFERRED_PROVIDER_virtual/kernel ?= "linux-amarula"
PREFERRED_PROVIDER_virtual/bootloader ?= "u-boot-mainline"

KERNEL_IMAGETYPE = "uImage"
KERNEL_DEVICETREE = "imx6ul-geam.dtb"
KERNEL_EXTRA_ARGS += "LOADADDR=${UBOOT_ENTRYPOINT}"

SPL_BINARY = "SPL"
UBOOT_SUFFIX = "img"
UBOOT_CONFIG ??= "sd nand"
UBOOT_CONFIG[sd] = "imx6ul_geam_mmc_config,sd"
UBOOT_CONFIG[nand] = "imx6ul_geam_nand_config,nand"

UBOOT_ENTRYPOINT = "0x80008000"
UBOOT_LOADADDRESS = "0x80008000"

MACHINE_FEATURES = "usbgadget usbhost vfat alsa"

IMAGE_BOOT_FILES ?= "${KERNEL_IMAGETYPE} ${KERNEL_DEVICETREE}"

### wic default support
WKS_FILE_DEPENDS ?= " \
        virtual/bootloader \
        e2fsprogs-native \
        bmap-tools-native \
        "
WKS_FILE = "engicam-spl-uboot-image.wks"

IMAGE_INSTALL_append = " usbutils"
```

## conf/machine/icorem6.conf
```bitbake
#@TYPE: Machine
#@NAME: icorem6

#@DESCRIPTION: Machine configuration for engicam systems
#EDIMM board with Quad/Dual and DualLite/Solo SOMs
#Above combination supports MMC and NAND booting

PREFERRED_PROVIDER_virtual/xserver ?= "xserver-xorg"
XSERVER ?= "xserver-xorg \
           xf86-video-fbdev \
           "

MACHINE_EXTRA_RRECOMMENDS = " kernel-modules kernel-devicetree"

include conf/machine/include/tune-cortexa9.inc
DEFAULTTUNE_icorem6 ?= "cortexa9thf-vfpv3"

IMAGE_FSTYPES += "wic"

SERIAL_CONSOLE = "115200 ttymxc3"

PREFERRED_PROVIDER_virtual/kernel ?= "linux-amarula"
PREFERRED_PROVIDER_virtual/bootloader ?= "u-boot-amarula"

KERNEL_IMAGETYPE = "uImage"
KERNEL_DEVICETREE = "imx6dl-icore.dtb imx6q-icore.dtb"
KERNEL_EXTRA_ARGS += "LOADADDR=${UBOOT_ENTRYPOINT}"

SPL_BINARY = "SPL"
UBOOT_SUFFIX = "img"
UBOOT_CONFIG ??= "nand sd"
UBOOT_CONFIG[sd] = "imx6qdl_icore_mmc_config,sd"
UBOOT_CONFIG[nand] = "imx6qdl_icore_nand_config,nand"
UBOOT_ENTRYPOINT = "0x10008000"
UBOOT_LOADADDRESS = "0x10008000"

MACHINE_FEATURES = "usbgadget usbhost vfat alsa"

IMAGE_BOOT_FILES ?= "${KERNEL_IMAGETYPE} ${KERNEL_DEVICETREE}"

### wic default support
WKS_FILE_DEPENDS ?= " \
        virtual/bootloader \
        e2fsprogs-native \
        bmap-tools-native \
        "
WKS_FILE = "engicam-spl-uboot-image.wks"

IMAGE_INSTALL_append = " usbutils"
```

## conf/machine/icorem6ctouch.conf
```bitbake
#@TYPE: Machine
#@NAME: icorem6ctouch

#@DESCRIPTION: Machine configuration for engicam
#@CTouch Carrier Board - supports only nand booting
#This board complete modules support is not present
#in mainline yet - so use custom uboot and linux for now

PREFERRED_PROVIDER_virtual/xserver ?= "xserver-xorg"
XSERVER ?= "xserver-xorg \
           xf86-video-fbdev \
           "

MACHINE_EXTRA_RRECOMMENDS = " kernel-devicetree"

include conf/machine/include/tune-cortexa9.inc
DEFAULTTUNE_icorem6 ?= "cortexa9thf-vfpv3"

IMAGE_FSTYPES += "wic"

SERIAL_CONSOLE = "115200 ttymxc3"

PREFERRED_PROVIDER_virtual/kernel ?= "linux-amarula"
PREFERRED_PROVIDER_virtual/bootloader ?= "u-boot-mainline"

KERNEL_IMAGETYPE = "uImage"
KERNEL_DEVICETREE = "imx6q-icore-ofcap10.dtb imx6q-icore-ofcap12.dtb"
KERNEL_EXTRA_ARGS += "LOADADDR=${UBOOT_ENTRYPOINT}"

SPL_BINARY = "SPL"
UBOOT_SUFFIX = "img"
UBOOT_MACHINE = "imx6qdl_icore_nand_config"
UBOOT_ENTRYPOINT = "0x10008000"
UBOOT_LOADADDRESS = "0x10008000"

MACHINE_FEATURES = "usbgadget usbhost vfat alsa"

IMAGE_BOOT_FILES ?= "${KERNEL_IMAGETYPE} ${KERNEL_DEVICETREE}"

### wic default support
WKS_FILE_DEPENDS ?= " \
        virtual/bootloader \
        e2fsprogs-native \
        bmap-tools-native \
        "
WKS_FILE = "engicam-spl-uboot-image.wks"

IMAGE_INSTALL_append = " usbutils"
```

## conf/machine/icorem6mipi.conf
```bitbake
#@TYPE: Machine
#@NAME: icorem6mipi

#@DESCRIPTION: Machine configuration for engicam systems
#EDIMM1.5 board with Qual/Dual MIPI and DualLite/Solo MIPI SOMs
#Above combination supports MMC and eMMC booting

PREFERRED_PROVIDER_virtual/xserver ?= "xserver-xorg"
XSERVER ?= "xserver-xorg \
           xf86-video-fbdev \
           "

MACHINE_EXTRA_RRECOMMENDS = " kernel-devicetree"

include conf/machine/include/tune-cortexa9.inc
DEFAULTTUNE_icorem6 ?= "cortexa9thf-vfpv3"

IMAGE_FSTYPES += "wic"

SERIAL_CONSOLE = "115200 ttymxc3"

PREFERRED_PROVIDER_virtual/kernel ?= "linux-amarula"
PREFERRED_PROVIDER_virtual/bootloader ?= "u-boot-mainline"

KERNEL_IMAGETYPE = "uImage"
KERNEL_DEVICETREE = "imx6dl-icore-mipi.dtb imx6q-icore-mipi.dtb"
KERNEL_EXTRA_ARGS += "LOADADDR=${UBOOT_ENTRYPOINT}"

SPL_BINARY = "SPL"
UBOOT_SUFFIX = "img"
UBOOT_MACHINE = "imx6qdl_icore_mipi_config"
UBOOT_ENTRYPOINT = "0x10008000"
UBOOT_LOADADDRESS = "0x10008000"

MACHINE_FEATURES = "usbgadget usbhost vfat alsa"

IMAGE_BOOT_FILES ?= "${KERNEL_IMAGETYPE} ${KERNEL_DEVICETREE}"

### wic default support
WKS_FILE_DEPENDS ?= " \
        virtual/bootloader \
        e2fsprogs-native \
        bmap-tools-native \
        "
WKS_FILE = "engicam-spl-uboot-image.wks"

IMAGE_INSTALL_append = " usbutils"
```

## conf/machine/icorem6rqs.conf
```bitbake
#@TYPE: Machine
#@NAME: icorem6rqs

#@DESCRIPTION: Machine configuration for engicam systems
#QSEVEN board with Qual/Dual rqs and DualLite/Solo rqs SOMs
#Above combination supports MMC and eMMC booting

PREFERRED_PROVIDER_virtual/xserver ?= "xserver-xorg"
XSERVER ?= "xserver-xorg \
           xf86-video-fbdev \
           "

MACHINE_EXTRA_RRECOMMENDS = " kernel-modules kernel-devicetree"

include conf/machine/include/tune-cortexa9.inc
DEFAULTTUNE_icorem6rqs ?= "cortexa9thf-vfpv3"

IMAGE_FSTYPES += "wic"

SERIAL_CONSOLE = "115200 ttymxc3"

PREFERRED_PROVIDER_virtual/kernel ?= "linux-amarula"
PREFERRED_PROVIDER_virtual/bootloader ?= "u-boot-amarula"

KERNEL_IMAGETYPE = "uImage"
KERNEL_DEVICETREE = "imx6dl-icore-rqs.dtb imx6q-icore-rqs.dtb"
KERNEL_EXTRA_ARGS += "LOADADDR=${UBOOT_ENTRYPOINT}"

SPL_BINARY = "SPL"
UBOOT_SUFFIX = "img"
UBOOT_MACHINE = "imx6qdl_icore_rqs_config"
UBOOT_ENTRYPOINT = "0x10008000"
UBOOT_LOADADDRESS = "0x10008000"

MACHINE_FEATURES = "usbgadget usbhost vfat alsa"

IMAGE_BOOT_FILES ?= "${KERNEL_IMAGETYPE} ${KERNEL_DEVICETREE}"

### wic default support
WKS_FILE_DEPENDS ?= " \
    virtual/bootloader \
    e2fsprogs-native \
    bmap-tools-native \
    "

WKS_FILE = "engicam-spl-uboot-image.wks"

IMAGE_INSTALL_append = " usbutils"
```

## conf/machine/isiot.conf
```bitbake
#@TYPE: Machine
#@NAME: isiot

#@DESCRIPTION: Machine configuration for engicam systems
#EDIMM Board with iSIOT eMMC/NAND SOMs
#iSIOT eMMC supports MMC and eMMC booting
#iSIOT NAND supports MMC and NAND booting

PREFERRED_PROVIDER_virtual/xserver ?= "xserver-xorg"
XSERVER ?= "xserver-xorg \
           xf86-video-fbdev \
           "

MACHINE_EXTRA_RRECOMMENDS = " kernel-modules kernel-devicetree"

include conf/machine/include/tune-cortexa9.inc
DEFAULTTUNE_isiot ?= "cortexa9thf-vfpv3"

IMAGE_FSTYPES += "wic"

SERIAL_CONSOLE = "115200 ttymxc0"

PREFERRED_PROVIDER_virtual/kernel ?= "linux-amarula"
PREFERRED_PROVIDER_virtual/bootloader ?= "u-boot-amarula"

KERNEL_IMAGETYPE = "uImage"
KERNEL_DEVICETREE = "imx6ul-isiot-emmc.dtb imx6ul-isiot-nand.dtb"
KERNEL_EXTRA_ARGS += "LOADADDR=${UBOOT_ENTRYPOINT}"

SPL_BINARY = "SPL"
UBOOT_SUFFIX = "img"
UBOOT_CONFIG ??= "nand sd"
UBOOT_CONFIG[sd] = "imx6ul_isiot_emmc_config,sd"
UBOOT_CONFIG[nand] = "imx6ul_isiot_nand_config,nand"

UBOOT_ENTRYPOINT = "0x80008000"
UBOOT_LOADADDRESS = "0x80008000"

MACHINE_FEATURES = "usbgadget usbhost vfat alsa"

IMAGE_BOOT_FILES ?= "${KERNEL_IMAGETYPE} ${KERNEL_DEVICETREE}"

### wic default support
WKS_FILE_DEPENDS ?= " \
	virtual/bootloader \
	e2fsprogs-native \
	bmap-tools-native \
	"
WKS_FILE = "engicam-spl-uboot-image.wks"

IMAGE_INSTALL_append = " usbutils"
```

## wic/engicam-spl-uboot-image.wks
```
# short-description: Create SD card image with a boot partition
# long-description:
# Create an image that can be written onto a SD card using dd for use
# with Engicam Board family.
# It uses SPL and u-boot
#
# The disk layout used is:
#  - ----- --------- -------------- --------------
# | | SPL | u-boot  |    boot      |    rootfs    |
#  - ----- --------- -------------- --------------
# ^ ^     ^         ^              ^
# | |     |         |              |
# 0 1kiB  69kiB   8MiB          56MiB + rootfs + IMAGE_EXTRA_SPACE (default 10MiB)
#
part SPL --source rawcopy --sourceparams="file=SPL" --ondisk mmcblk --no-table --align 1
part u-boot --source rawcopy --sourceparams="file=u-boot.img" --ondisk mmcblk --no-table --align 69
part /boot --source bootimg-partition --ondisk mmcblk --fstype=vfat --label boot --active --align 8192 --size 32
part / --source rootfs --ondisk mmcblk --fstype=ext2 --label root --align 8192 

bootloader --ptable msdos
```
